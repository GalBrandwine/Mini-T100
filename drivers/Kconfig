## drivers/Kconfig
```kconfig
# Copyright (c) 2021 Nordic Semiconductor ASA
# SPDX-License-Identifier: Apache-2.0

menu "Drivers"
rsource "motor/l298n_motor/Kconfig"
endmenu
```

## drivers/motor/l298n_motor/Kconfig
```kconfig
# Copyright (c) 2024 Nordic Semiconductor ASA
# SPDX-License-Identifier: Apache-2.0

menuconfig MOTOR
	bool "Stepper motor drivers"
	help
	  This option enables the blink custom driver class.

if MOTOR

config MOTOR_INIT_PRIORITY
	int "Motor device drivers init priority"
	default KERNEL_INIT_PRIORITY_DEVICE
	help
	  Motor device drivers init priority.

module = MOTOR
module-str = motor
source "subsys/logging/Kconfig.template.log_config"

rsource "Kconfig.l298n_motor"

endif # MOTOR
```

## drivers/motor/l298n_motor/Kconfig.l298n_motor
```kconfig
# Copyright (c) 2024 Nordic Semiconductor ASA
# SPDX-License-Identifier: Apache-2.0

config L298N_MOTOR
	bool "GPIO-PWM-controlled dc motor driver"
	default y
	# depends on DT_HAS_BLINK_GPIO_LED_ENABLED
	select GPIO
	select PWM
	help
	  Enable this option to use the GPIO-PWM-controlled dc motor driver
```

## drivers/motor/stepper_motor/Kconfig
```kconfig
# Copyright (c) 2024 Nordic Semiconductor ASA
# SPDX-License-Identifier: Apache-2.0

menuconfig STEPPER_MOTOR
	bool "Stepper motor drivers"
	help
	  This option enables the blink custom driver class.

if STEPPER_MOTOR

# config STEPPER_MOTOR_PRIORITY
# 	int "Blink device drivers init priority"
# 	default KERNEL_INIT_PRIORITY_DEVICE
# 	help
# 	  Blink device drivers init priority.

module = STEPPER_MOTOR
module-str = stepper_motor
source "subsys/logging/Kconfig.template.log_config"

rsource "Kconfig.gpio_stepper_motor"

endif # STEPPER_MOTOR
```

## drivers/motor/stepper_motor/Kconfig.gpio_stepper_motor
```kconfig
# Copyright (c) 2024 Nordic Semiconductor ASA
# SPDX-License-Identifier: Apache-2.0

config GPIO_STEPPER_MOTOR
	bool "GPIO-PWM-controlled stepper motor driver"
	default y
	# depends on DT_HAS_BLINK_GPIO_LED_ENABLED
	select GPIO
	select PWM
	help
	  Enable this option to use the GPIO-controlled STEPPER_MOTTOR driver.
```

## dts/bindings/motor/galbrandwine,motor-l298n.yaml
```yaml
# Copyright (c) 2024 Nordic Semiconductor ASA
# SPDX-License-Identifier: Apache-2.0

description: |
  A generic binding for a GPIO-controlled blinking LED. Note that this binding
  has no vendor prefix, as it does not target a specific device or vendor.

  Example definition in devicetree:

    left-motor-gpio {
        compatible = "motor-gpio";
        led-gpios = <&gpio0 0 GPIO_ACTIVE_HIGH>;
        blink-period-ms = <1000>;
    };

compatible: "galbrandwine,motor-l298n"

include: [base.yaml]

properties:
  motor-side:
    type: string
    required: true
    description: Human description for motor side (Left\Right)
    enum:
      - "Left"
      - "Right"
  left-motors:
    type: phandle-array
    required: true
    description: ENB pin (usually for enable the motor \ or controlling with PWM )

  # left-gpios:
  #   type: phandle-array
  #   required: true
  #   description: Wires for motor B

  # l298n-pin-pwm-as:
  #   type: phandle-array
  #   required: true
  #   description: ENB pin (usually for enable the motor \ or controlling with PWM )
  # l298n-pin-in1s:
  #   type: phandle-array
  #   required: true
  #   description: Wire +  of motor B
  # l298n-pin-in2s:
  #   type: phandle-array
  #   required: true
  #   description: Wire -  of motor B
  # blink-period-ms:
  #   type: int
  #   description: Initial blinking period in milliseconds.
```

## dts/bindings/motor/motor-gpio.yaml
```yaml
# Copyright (c) 2024 Nordic Semiconductor ASA
# SPDX-License-Identifier: Apache-2.0

description: |
  A generic binding for a GPIO-controlled blinking LED. Note that this binding
  has no vendor prefix, as it does not target a specific device or vendor.

  Example definition in devicetree:

    left-motor-gpio {
        compatible = "motor-gpio";
        # led-gpios = <&gpio0 0 GPIO_ACTIVE_HIGH>;
        blink-period-ms = <1000>;
    };

compatible: "motor-gpio"

# include: base.yaml

properties:
  gals_property:
    type: string
    required: true
    description: Dummy property for learning Zephyr's DTS
    enum:
      - "Gal"
      - "Is"
      - "Learning"
      - "Zephyr"
  # led-gpios:
  #   type: phandle-array
  #   required: true
  #   description: GPIO-controlled LED.

  # blink-period-ms:
  #   type: int
  #   description: Initial blinking period in milliseconds.
```
